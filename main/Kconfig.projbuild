## main/Kconfig.projbuild
```kconfig
menu "nRF24L01+ CanSat example"

choice NRF24_EXAMPLE_ROLE
    prompt "Application role"
    default NRF24_EXAMPLE_TX

    config NRF24_EXAMPLE_TX
        bool "CanSat transmitter (main_Tx.c)"

    config NRF24_EXAMPLE_RX
        bool "Ground receiver (main_Rx.c)"
endchoice

endmenu
```

## sdkconfig.defaults
```kconfig
# Configuracion base para ESP32-S3 / ESP-IDF 5.4.
CONFIG_IDF_TARGET="esp32s3"
CONFIG_ESP_DEFAULT_CPU_FREQ_MHZ_160=y
CONFIG_FREERTOS_HZ=100
CONFIG_ESPTOOLPY_FLASHSIZE_2MB=y
CONFIG_PARTITION_TABLE_SINGLE_APP=y
CONFIG_ESP_CONSOLE_UART_DEFAULT=y
CONFIG_ESP_CONSOLE_UART_BAUDRATE=115200
CONFIG_ESP_CONSOLE_SECONDARY_USB_SERIAL_JTAG=y
```
